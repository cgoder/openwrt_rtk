## rtk_openwrt_sdk/package/utils/bluez/Config.in
```kconfig
# bluez package config

menu "Serial Chip Selection"
	depends on PACKAGE_bluez

config SERIAL_RTL_8761A
	bool "rtl8761a"
	default y
	select BUSYBOX_CUSTOM
	select BUSYBOX_CONFIG_MDEV
	select BUSYBOX_CONFIG_FEATURE_MDEV_CONF
	select BUSYBOX_CONFIG_FEATURE_MDEV_RENAME
	select BUSYBOX_CONFIG_FEATURE_MDEV_RENAME_REGEXP
	select BUSYBOX_CONFIG_FEATURE_MDEV_EXEC
    select BUSYBOX_CONFIG_FEATURE_MDEV_LOAD_FIRMWARE
	help
	  rtl8761a serial bluetooth chip
endmenu

menu "USB Chip Selection"
	depends on PACKAGE_bluez

config USB_RTL_8761A
	bool "rtl8761a"
	default y
	select BUSYBOX_CUSTOM
	select BUSYBOX_CONFIG_MDEV
	select BUSYBOX_CONFIG_FEATURE_MDEV_CONF
	select BUSYBOX_CONFIG_FEATURE_MDEV_RENAME
	select BUSYBOX_CONFIG_FEATURE_MDEV_RENAME_REGEXP
	select BUSYBOX_CONFIG_FEATURE_MDEV_EXEC
    select BUSYBOX_CONFIG_FEATURE_MDEV_LOAD_FIRMWARE
	help
	  rtl8761a usb bluetooth chip
endmenu
```

## rtk_openwrt_sdk/target/linux/realtek/files/arch/mips/rtl8197f/Kconfig
```kconfig
if REALTEK_97F
source "arch/mips/rtl8197f/Kconfig.legacy"
choice
	prompt "Realtek SoC selection"
	default SOC_RTL8197F
	help
	  Select Realtek MIPS SoC type.

	config SOC_RTL8197F
		bool "RTL8197F"
		select RTL_8197F
		select SYS_SUPPORTS_LITTLE_ENDIAN
                select OPENWRT_SDK
                select WRT_BARRIER_BREAKER
endchoice
choice
        prompt "Develop platform selection"
        default RTL_8197F_WRT
        help
          Select the platform.

        config RTL_8197F_WRT
                bool "8197F OpenWRT BSP"
                select RTL_8197F_GW
                select OPENWRT_SDK
                select WRT_BARRIER_BREAKER
		select USB_ARCH_HAS_EHCI
                select ARCH_REQUIRE_GPIOLIB
                depends on SOC_RTL8197F

endchoice

config RTL_FLASH_SIZE
        hex "97f flash size"
        default "0x800000"
        help
          Select the flash size the you need.

config RTK_BOOTINFO_DUALIMAGE
	bool "DualImage Support(OpenWRT SDK)"
	default n
comment "Second Bank Offset"
	depends on RTK_BOOTINFO_DUALIMAGE
config RTK_DUALIMAGE_FLASH_OFFSET
	hex "flash offset"
	depends on RTK_BOOTINFO_DUALIMAGE
	default "0x400000"
	help
	  offset of second bank, in most case it should be half of your flash size.
endif
```

## rtk_openwrt_sdk/target/linux/rtkmips/files/arch/mips/realtek/Kconfig
```kconfig
if REALTEK
source "arch/mips/realtek/Kconfig.legacy"
choice
	prompt "Realtek mips SoC selection"
	default SOC_RTL8198C
        help
          Select Realtek MIPS SoC type.	
	
	config SOC_RTL8198C
		bool "rtl8198c"
		select MIPS_CPU_SCACHE
                select SYS_SUPPORTS_SMP
                select SYS_SUPPORTS_MIPS_CMP
                select IRQ_GIC
		select USB_ARCH_HAS_XHCI
		select HW_HAS_PCI
		select SYS_SUPPORTS_HIGHMEM
endchoice

choice
        prompt "Develop platform selection"
        default RTL_8198C_WRT
        help
          Select the platform.

        config RTL_8198C_WRT
                bool "8198C OpenWRT BSP"
		select RTL_8198C_GW
		select OPENWRT_SDK
		select WRT_BARRIER_BREAKER
		select RTK_XHCI_USB
		select USB_XHCI_PLATFORM
		select ARCH_REQUIRE_GPIOLIB
                depends on SOC_RTL8198C

endchoice

config RTK_BOOTINFO_DUALIMAGE
        bool "DualImage Support(OpenWRT SDK)"
        default n
comment "Second Bank Offset"
        depends on RTK_BOOTINFO_DUALIMAGE
config RTK_DUALIMAGE_FLASH_OFFSET
        hex "flash offset"
        depends on RTK_BOOTINFO_DUALIMAGE
        default "0x400000"
        help
          offset of second bank, in most case it should be half of your flash size.

config RTK_XHCI_USB
	def_bool n

config SPI_3to4BYTES_ADDRESS_SUPPORT
	bool "SPI 32MB support from 3Byte to 4byte mapping"
	default n
endif
```

## rtk_openwrt_sdk/target/linux/rtkmips/files/arch/mips/realtek/Kconfig.legacy
```kconfig
config RTL_8198C_GW
	bool
        select RTL_8198C
        select SYS_HAS_EARLY_PRINTK
	default n

config RTL_8198C
        bool
	select RTL_819X
        default y

# common flag for Realtek 819X SoC
config RTL_819X
        bool	
        default y

## kernel option flag for openWrt SDK
config OPENWRT_SDK
        def_bool n

config WRT_BARRIER_BREAKER
        def_bool n
```

## rtk_openwrt_sdk/target/linux/rtkmips/files/arch/rlx/config.in
```kconfig
#
# Realtek Semiconductor Corp.
#
# Tony Wu (tonywu@realtek.com)
# Dec. 7, 2009
#

#
# SoC feature
#
config RTL_8196C
	select ARCH_CPU_RLX4181
	select RTL_819X
	def_bool n

config RTL_8196E
	select ARCH_CPU_RLX4181
	select ARCH_CPU_SLEEP
	select RTL_819X
	select GENERIC_GPIO
	select GPIOLIB
	select OPENWRT_SDK
	select WRT_BARRIER_BREAKER
	def_bool n

config RTL_819XD
	select ARCH_CPU_RLX5281
	select RTL_819X
	select GENERIC_GPIO
	select GPIOLIB
	select OPENWRT_SDK
	select WRT_BARRIER_BREAKER
	def_bool n

config RTL_8881A
	select ARCH_CPU_RLX5281
	select RTL_819X
	select RTL_8196D	
	select GENERIC_GPIO
	select GPIOLIB
        select OPENWRT_SDK
        select WRT_BARRIER_BREAKER
	def_bool n

config RTL_8196D
	select RTL_819XD
	def_bool n

config RTL_8197D
	select RTL_819XD
	def_bool n
	
config RTL_819XD_GW
	def_bool n

config RTL_819X
	def_bool n

## kernel option flag for openWrt SDK
config OPENWRT_SDK
	def_bool n

config WRT_BARRIER_BREAKER
	def_bool n
####################################
#
# CPU feature
#
comment "CPU features"

config BSP_ENABLE_RADIAX
	bool "Enable RADIAX support"
	default n
	depends on ARCH_CPU_RADIAX

config BSP_ENABLE_TLS
	bool "Enable Taroko TLS support"
	default n
	depends on ARCH_CPU_TLS

config BSP_ENABLE_WMPU
	bool "Enable Taroko WMPU support"
	default n
	depends on ARCH_CPU_WMPU

#
# FPGA
#
config FPGA_PLATFORM
	bool

#
# BSP
#
menu "BSP configuration"

#
# memory
#
config RTL_SDRAM_GE_32M
	bool "sdram size greater than or equal 32M"
	default n

#
# flash
#

#
# timer
#
choice
	prompt "Timer Source"

config ARCH_CEVT_RLX
	bool "Use RLX internal timer"
	depends on ARCH_CPU_TIMER

config ARCH_CEVT_EXT
	bool "Use EXT external timer"

endchoice

config RTL_WTDOG
	bool "Enable watchdog timer support"

config RTL_TIMER_ADJUSTMENT
	bool "Enable timer adjustment support"

#
# uart
#

#
# switch
# 
config RTL_8211DS_SUPPORT
	bool "Support rtl8211ds for rtl8197D"
	default n
	depends on RTL_8197D

#
# wifi
# 
config RTL_PCIE_SIMPLE_INIT
	bool
	default y if RTL8192SE
	default y if RTL8192CD

config RTL_BRSC
	bool "BRSC support"
	default n

config RTL_NETDEV_NO_PRIV
	bool "Support reference priv through netdev_priv"
	default n

config AUTO_PCIE_PHY_SCAN
	bool "819x PCIE Autoscan PCIE PHY 40Mhz"
	default n

#config PHY_EAT_40MHZ
#	bool "819x clock source at 40Mhz"
#	default y

config RTL_EAP_RELAY
	bool
	
config RTL_HOSTAPD_SUPPORT
	bool

config RTK_INBAND_HOST_HACK
	bool

#
# pci
#
config BSP_ENABLE_PCI
	bool "Enable PCI controller"
	default n
#
# usb
#
config BSP_ENABLE_USB
	bool "Enable USB controller"
	default n

config RTL_USB_IP_HOST_SPEEDUP
	bool "Seedup usb samba performance"
	default n
# dualimage
config RTK_BOOTINFO_DUALIMAGE
	bool "DualImage Support(OpenWRT SDK)"
	default n
comment "Second Bank Offset"
	depends on RTK_BOOTINFO_DUALIMAGE
config RTK_DUALIMAGE_FLASH_OFFSET
        hex "flash offset"
        depends on RTK_BOOTINFO_DUALIMAGE
        default "0x400000"
        help
          offset of second bank, Normally should be above 4M for OpenWRT image.

#
# misc
#
config RTL_NFBI_MDIO
	bool

endmenu
```

## rtk_openwrt_sdk/target/linux/rtkmips/files/arch/rlx/soc-rtl8881a/config.in
```kconfig
#
# Board Configuration
#
menu "Board Configuration"

choice
	prompt "Board"
	default RTL_8881A

config RTL_8881A
        bool "8881A"
		select RTL_8196D
		select RTL_819XD_GW
		#select RTL819X_SPI_FLASH
#		select AUTO_PCIE_PHY_SCAN
		select RTL_NETDEV_NO_PRIV
                select ARCH_BUS_USB
                select BSP_ENABLE_USB
                select USB_ARCH_HAS_EHCI
                select USB_ARCH_HAS_OHCI

#config RTL_8196D_GW
#	bool "96D+92D GW"
	#select FPGA_PLATFORM
#	select RTL_8196D
#	select RTL_819XD_GW
#	select RTL_8881A
#	select RTL819X_SPI_FLASH
#	select AUTO_PCIE_PHY_SCAN
#	select RTL_NETDEV_NO_PRIV
#	help
#		This enables support for Realtek RTL8196D demo board

#config RTL_8197D_GW
#	bool "97D+92C+92D GW"
#	select RTL_8197D
#	select RTL_819XD_GW
#	select RTL819X_SPI_FLASH
#	select RTL_NETDEV_NO_PRIV
#	help
#		This enables support for Realtek RTL8197D demo board
          
endchoice

endmenu
```

## rtk_openwrt_sdk/target/linux/rtkmipsel/files/arch/rlx/Kconfig.rlx
```kconfig
#
# Realtek Semiconductor Corp.
#
# RLX Linux Kernel Configuration
#
# Tony Wu (tonywu@realtek.com)
# Dec. 07, 2008
#

#source "../target/selection/config.cpu"
#source "../target/selection/config.in"
source "arch/rlx/config.cpu"

menu "CPU configuration"

config CPU_ENABLE_FPU
	bool "Enable Taroko FPU support"
	default n
	depends on ARCH_CPU_FPU

config CPU_ENABLE_RADIAX
	bool "Enable RADIAX support"
	default n
	depends on ARCH_CPU_RADIAX

config CPU_ENABLE_TLS
	bool "Enable Taroko TLS support"
	default y
	depends on ARCH_CPU_TLS

config CPU_ENABLE_WMPU
	bool "Enable Taroko WMPU support"
	default n
	depends on ARCH_CPU_WMPU

endmenu

#
# RLX
#
config RLX
	bool
	default y
	select BOOT_ELF32
	select SYS_SUPPORTS_ARBIT_HZ
	select SYS_HAS_EARLY_PRINTK

config MACH_RLX
	bool
	default y
	select CPU_SUPPORTS_HIGHMEM
	select CPU_SUPPORTS_32BIT_KERNEL
	select SYS_SUPPORTS_32BIT_KERNEL
	select SYS_SUPPORTS_LITTLE_ENDIAN if ARCH_CPU_EL
	select SYS_SUPPORTS_BIG_ENDIAN if ARCH_CPU_EB
	select SYS_SUPPORTS_SMP if ARCH_CPU_SMP
	select SYS_SUPPORTS_CMP if ARCH_CPU_SMP
	select IRQ_CPU if ARCH_IRQ_CPU
	select IRQ_VEC if ARCH_IRQ_VEC
	select IRQ_GIC if ARCH_IRQ_GIC
	select HW_HAS_PCI if (ARCH_BUS_PCI && BSP_ENABLE_PCI)
	select HW_HAS_USB if (ARCH_BUS_USB && BSP_ENABLE_USB)
	select ARCH_SUPPORTS_MSI if (ARCH_BUS_PCI_MSI && BSP_ENABLE_PCI)
	select CPU_HAS_FPU if CPU_ENABLE_FPU
	select CPU_HAS_LLSC if ARCH_CPU_LLSC
	select CPU_HAS_RADIAX if CPU_ENABLE_RADIAX
	select CPU_HAS_SLEEP if ARCH_CPU_SLEEP
	select CPU_HAS_SYNC if ARCH_CPU_SYNC
	select CPU_HAS_TLS if CPU_ENABLE_TLS
	select CPU_HAS_ULS if ARCH_CPU_ULS
	select CPU_HAS_WMPU if CPU_ENABLE_WMPU
	select DMA_COHERENT if ARCH_CACHE_CAP
	select DMA_NONCOHERENT if !ARCH_CACHE_CAP

#
# CPU
#
config CPU_RLX4181
	bool
	default y if ARCH_CPU_RLX4181

config CPU_RLX5181
	bool
	default y if ARCH_CPU_RLX5181
	select CPU_HAS_CLS

config CPU_RLX5280
	bool
	default y if ARCH_CPU_RLX5280
	select CPU_HAS_CLS

config CPU_RLX4281
	bool
	select CPU_HAS_BUS_ERROR
	default y if ARCH_CPU_RLX4281 || ARCH_CPU_RLX4381
	default y if ARCH_CPU_RLX4271 || ARCH_CPU_RLX4371

config CPU_RLX5281
	bool
	select CPU_HAS_BUS_ERROR
	default y if ARCH_CPU_RLX5281 || ARCH_CPU_RLX5381
	default y if ARCH_CPU_RLX5271 || ARCH_CPU_RLX5371
	select CPU_HAS_CLS

config CPU_HAS_RADIAX
	bool

config CPU_HAS_SLEEP
	bool

config CPU_HAS_CLS
	bool

config CPU_HAS_FPU
	bool

config CPU_HAS_LLSC
	bool

config CPU_HAS_ULS
	bool

config CPU_HAS_TLS
	bool
    default y if ARCH_CPU_TLS

config CPU_HAS_LLSC
	bool

config CPU_HAS_BUS_ERROR
	bool

config CPU_HAS_WMPU
	bool
	select HARDWARE_WATCHPOINTS

#
# IRQ
#
config IRQ_VEC
	bool

#
# Timer
#
config CEVT_EXT
	bool
	default y if ARCH_CEVT_EXT
	default y if !CPU_RLX4281 && !CPU_RLX5281

config CEVT_RLX
	bool
	default y if ARCH_CEVT_RLX
	default n if !CPU_RLX4281 && !CPU_RLX5281

config CSRC_RLX
	bool
	default y if ARCH_CEVT_RLX
	default n if !CPU_RLX4281 && !CPU_RLX5281

#
# CACHE
#
config CPU_HAS_WBC
	bool
	default y if ARCH_CACHE_WBC

config CPU_HAS_L2C
	bool
	default y if ARCH_CACHE_L2C

config CPU_HAS_WBIC
	bool
	default y if ARCH_CACHE_WBIC

#
# BUS
#
config HW_HAS_USB
	bool

#
# MISC
#
config USE_UAPI
	bool
	default y
	help
	  Starting Linux 3.7, UAPI is enabled.
```

## rtk_openwrt_sdk/target/linux/rtkmipsel/files/arch/rlx/soc-rtl8196e/config.in
```kconfig
#
# Board Configuration
#
menu "Board Configuration"

choice
	prompt "Board"
	default RTL_8196E_GW

config RTL_8196E_GW
	bool "96E GW"
	#select FPGA_PLATFORM
	select RTL_8196E
	select RTL_SDRAM_GE_32M
	select RTL819X_SPI_FLASH
	select AUTO_PCIE_PHY_SCAN
	select RTL_NETDEV_NO_PRIV
    select CONFIG_RTL_USB_OTG
	select ARCH_BUS_USB
	select BSP_ENABLE_USB
	select USB_ARCH_HAS_EHCI
	select USB_ARCH_HAS_OHCI
	help
		This enables support for Realtek RTL8196E demo board

endchoice

endmenu
```
